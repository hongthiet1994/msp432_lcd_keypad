#include "driverlib.h"
#include <stdint.h>
#include <stdbool.h>
#include <stdio.h>
#include <time.h>
#include <stdlib.h>
#include "module_display.h"
#include "lcd_st7565_lib.h"
#include "module_keypad.h"

// For keypad
extern uint8_t ui8_key_press;

// For display
extern uint16_t ui16_idle;
int8_t x_blink = 0,y_blink = 0;


extern uint8_t ui8_state;
extern int8_t line_in_list;


extern int8_t line_in_menu;
extern int8_t line_in_manage;

char logo [] = {
  0x00, 0x00, 0x00, 0x00, 0x00, 0x00, 0x00, 0x00, 0x00, 0x00, 0x80, 0x80, 0xC0, 0x60, 0x30, 0x18,
  0x18, 0x0C, 0x04, 0x04, 0x06, 0x02, 0x03, 0x01, 0x01, 0x01, 0x01, 0x01, 0x01, 0x01, 0x01, 0x03,
  0x03, 0x02, 0x02, 0x06, 0x06, 0x04, 0x0C, 0x18, 0x10, 0x30, 0x20, 0x60, 0xC0, 0x00, 0x00, 0x00,
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  0x00, 0x00, 0x00, 0x00, 0x00, 0x00, 0x00, 0x00, 0x00, 0x00, 0x00, 0x00, 0x00, 0x00, 0x00, 0x00
};


void begin()
{  
  Interrupt_disableInterrupt(INT_T32_INT2);
  Timer32_disableInterrupt(TIMER32_1_BASE);
  clear_all_LCD(); 
  glcd_gotoxy(0,0);
  lcd_image(0,0,logo,128,64);
  ui8_state = STATE_IDLE;
  line_in_list=line_in_manage=line_in_menu = 0;
  Interrupt_enableInterrupt(INT_PORT2);
}


void init_LCD(void)
{
  
  GPIO_setAsOutputPin(PORT_LCD_SPI, GPIO_PIN0 + GPIO_PIN2 + GPIO_PIN4 + GPIO_PIN5 );
  GPIO_setAsOutputPin(PORT_LCD_RESET, PIN_LCD_RESET );
  GPIO_setOutputLowOnPin(PORT_LCD_RESET, PIN_LCD_RESET);
  GPIO_setOutputHighOnPin(PORT_LCD_RESET, PIN_LCD_RESET);
  lcd_write(0,0xE2); 
  lcd_write(0,0xAF); 
  lcd_write(0,0x2F); 
}

void display_screen_delete_user()
{  
  ui8_state = STATE_DELETE;
  clear_all_LCD();  
  lcd_gotoxy(2,2);
  lcd_puts("Are you sure want ",1);
  lcd_gotoxy(3,3); 
  lcd_puts("delete this user",1);
  lcd_gotoxy(4,5);
  lcd_puts("Yes: Enter",1);
  lcd_gotoxy(4,6);
  lcd_puts("No : Back",1);
}



/*
// The function returns the function of the key that corresponds to each mode
*/
void process_keypad(void)
{
  switch (ui8_state)
  {
  case STATE_IDLE :
    if(ui8_key_press == KEY_ENTER)
    {
      login();
    }
    check_tag_RFID();
    break;
  case STATE_LOGIN :
    get_character();
    check_tag_RFID(); 
    break;
  case STATE_MENU :
    menu_returnKey();
    break;
  case STATE_INFOR :
    if(ui8_key_press == KEY_BACK)
    {
      menu();
    }
    break;
  case STATE_PROFILE :
    profile_returnKey();
    break;
  case STATE_ADD_USER :
    get_character();
    break;
  case STATE_MANAGE :
    manage_returnKey();
    break;
  case STATE_DELETE :
    delete_returnKey();
    break;
  case STATE_CHANGEPASS :
    get_character();
    break;
  case STATE_LIST :
    list_returnKey();
    break;
  case STATE_ADD_RFID_CODE :
    RFID_returnKey();
    break;
  case STATE_CHOOSE : 
    if(ui8_key_press == KEY_ENTER)
    {
      ui16_idle = 0;
      menu();
    }
    break;
  default :
    break;
  }
  
}

// abc or ABC or 123
void display_icon_type_input(uint8_t ui8_type_input)
{
  uint8_t temp = ui8_type_input%3;
  switch(temp)
  {
  case INPUT_LOWERCASE_LETTERS:
    lcd_gotoxy(18,0);
    lcd_puts("abc",0);
    break;
  case INPUT_CAPITAL_LETTER:
    lcd_gotoxy(18,0);
    lcd_puts("ABC",0);
    break;
  case INPUT_NUMBER:
    lcd_gotoxy(18,0);
    lcd_puts("123",0);
    break;  
  }
}

void display_icon_blink(uint8_t value,uint8_t x,uint8_t y)
{
  if(value%2)
  {
    display_icon(ICON_BLINK_UP,x,y,COLOR_BLACK);
  }
  else
  {
    display_icon(ICON_BLINK_DOWN,x,y,COLOR_BLACK);
  }
}
